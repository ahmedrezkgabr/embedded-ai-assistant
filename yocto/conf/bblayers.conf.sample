## yocto/conf/bblayers.conf.sample
```bitbake
BBLAYERS ?= " \
  ${TOPDIR}/../poky/meta \
  ${TOPDIR}/../poky/meta-poky \
  ${TOPDIR}/../poky/meta-yocto-bsp \
  ${TOPDIR}/../meta-openembedded/meta-oe \
  ${TOPDIR}/../meta-openembedded/meta-python \
  ${TOPDIR}/../meta-openembedded/meta-multimedia \
  ${TOPDIR}/../meta-openembedded/meta-networking \
  ${TOPDIR}/../meta-nodejs \
  ${TOPDIR}/../meta-raspberrypi \
  ${TOPDIR}/../meta-ai-assistant \
"
```

## yocto/conf/local.conf.sample
```bitbake
MACHINE = "qemux86-64"
DISTRO = "poky"
EXTRA_IMAGE_FEATURES += "debug-tweaks"
PACKAGE_CLASSES ?= "package_ipk"
IMAGE_ROOTFS_EXTRA_SPACE = "4194304"

DISTRO_FEATURES:append = " systemd"
VIRTUAL-RUNTIME_init_manager = "systemd"
DISTRO_FEATURES_BACKFILL_CONSIDERED:append = " sysvinit"
```

## yocto/meta-ai-assistant/conf/layer.conf
```bitbake
BBPATH .= ":${LAYERDIR}"

BBFILES += "${LAYERDIR}/recipes-*/*/*.bb \
            ${LAYERDIR}/recipes-*/*/*.bbappend"

BBFILE_COLLECTIONS += "meta-ai-assistant"
BBFILE_PATTERN_meta-ai-assistant = "^${LAYERDIR}/"
BBFILE_PRIORITY_meta-ai-assistant = "8"

LAYERDEPENDS_meta-ai-assistant = "core openembedded-layer meta-python multimedia-layer networking-layer nodejs-layer"

LAYERSERIES_COMPAT_meta-ai-assistant = "scarthgap"
```
